## config/boards/shields/basicnumpad/Kconfig.defconfig
```kconfig
if SHIELD_BASICNUMPAD

# Name must be less than 16 characters long!
config ZMK_KEYBOARD_NAME
    default "Basicnumpad"

endif
```

## config/boards/shields/basicnumpad/Kconfig.shield
```kconfig
# No whitespace after the comma or in your keyboard name!
config SHIELD_BASICNUMPAD
    def_bool $(shields_list_contains,basicnumpad)
```

## config/west.yml
```yaml
manifest:
  remotes:
    - name: zmkfirmware
      url-base: https://github.com/zmkfirmware
    - name: basicnumpad
      url-base: https://github.com/thewickest/basicnumpad-module
    # Additional modules containing boards/shields/custom code can be listed here as well
    # See https://docs.zephyrproject.org/3.2.0/develop/west/manifest.html#projects
  projects:
    - name: zmk
      remote: zmkfirmware
      revision: main
      import: app/west.yml
    - name: basicnumpad
      remote: thewickest
      revision: main
  self:
    path: config
```
